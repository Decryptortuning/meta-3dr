## conf/distro/3dr-imx-fb.conf
```bitbake
# 3DR Solo distro on top of NXP i.MX Scarthgap framebuffer distro.
#
# This keeps NXP BSP defaults but switches init back to sysvinit so legacy
# /etc/init.d + rc?.d scripts in meta-3dr work without a systemd port.

require conf/distro/fsl-imx-fb.conf

DISTRO = "3dr-imx-fb"
DISTRO_NAME = "3DR Solo (NXP i.MX) - Framebuffer"

# fsl-imx-* sets systemd by default; override to keep the legacy init flow.
POKY_INIT_MANAGER = "sysvinit"
INIT_MANAGER = "sysvinit"

# Prefer modern Python module recipes from poky/meta-* over the legacy copies
# in meta-3dr (some no longer build with Python 3.12 used by Scarthgap).
PREFERRED_VERSION_python3-pyserial = "3.5"
PREFERRED_VERSION_python3-pyparsing = "3.1.1"

# Prefer maintained core recipes over legacy meta-3dr copies.
PREFERRED_VERSION_iw = "6.7"
```
